## boards/charybdis4x6_right.conf
```kconfig
CONFIG_SPI=y
CONFIG_INPUT=y
CONFIG_ZMK_MOUSE=y
CONFIG_PMW3610=y

# 연결 안정성
CONFIG_BT_CTLR_TX_PWR_PLUS_8=y
CONFIG_ZMK_BLE_EXPERIMENTAL_CONN=y

# 트랙볼 부드럽게
CONFIG_PMW3610_POLLING_RATE_125_SW=y
CONFIG_PMW3610_SMART_ALGORITHM=y

# [핵심 수정] 아까 반대로 움직였죠? 이걸 켜면 정상으로 돌아옵니다.
CONFIG_PMW3610_INVERT_X=y
CONFIG_PMW3610_INVERT_Y=y
```
